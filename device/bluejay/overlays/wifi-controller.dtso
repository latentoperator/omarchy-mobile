// SPDX-License-Identifier: GPL-2.0-only
/* Historical c934e316b controller path, which has no regulator-wlan node.
 * The reviewed GS101 stack uses wifi-reviewed-controller instead.
 * Requires wifi-pool, live pool qualification and blacklisted modules.
 * Controller stages 0-4 only, under the guarded single-attempt runner.
 * Applying this overlay alone does not authorize a driver load.
 */
/dts-v1/;
/plugin/;

/ {
	fragment@0 {
		target-path = "/soc@0/phy@14550000";
		__overlay__ {
			status = "okay";
		};
	};
	fragment@1 {
		target-path = "/soc@0/pcie@14520000";
		__overlay__ {
			status = "okay";
		};
	};
};
